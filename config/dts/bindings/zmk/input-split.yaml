## config/dts/bindings/zmk/input-split.yaml
```yaml
# SPDX-License-Identifier: MIT
compatible: "zmk,input-split-ext"  # ← ZMK本体とバッティングしないように名前変更

description: Custom binding for input-split to avoid conflict

include: base.yaml

properties:
  input:
    required: true
    type: phandle
```

## config/west.yml
```yaml
manifest:
  remotes:
    - name: zmkfirmware
      url-base: https://github.com/zmkfirmware
    - name: sayu-hub
      url-base: https://github.com/sayu-hub
    - name: caksoylar  # <-- new entry
      url-base: https://github.com/caksoylar
    - name: kzyz  # <-- 新しく追加するリモート名
      url-base: https://github.com/kzyz
    - name: prospector                            # <--- add this
      url-base: https://github.com/t-ogura     # <--- and this
  projects:
    - name: zmk
      remote: zmkfirmware
      revision: main
      import: app/west.yml
    - name: zmk-pmw3610-driver
      remote: sayu-hub
      revision: main
    - name: zmk-rgbled-widget  # <-- new entry
      remote: caksoylar
      revision: main
    - name: zmk-az1uball-driver  # <-- zmk-az1uball-driver を az1uball-test に置き換え
      remote: kzyz  # <-- 新しいリモート名を指定
      revision: main
      #path: modules/az1
    - name: prospector-zmk-module
      remote: prospector
      revision: feature/v1.1-fixes
      #path: modules/prospector-zmk-module
  self:
    path: config
```
